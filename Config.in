## configs/pic32mzda_evk_defconfig
```kconfig
BR2_mipsel=y
BR2_mips_32r2=y
BR2_PRIMARY_SITE="http://linux.microchip.com"
BR2_PACKAGE_OVERRIDE_FILE="$(BR2_EXTERNAL)/local.mk"
BR2_GLOBAL_PATCH_DIR="$(BR2_EXTERNAL)/patches"
BR2_TOOLCHAIN_EXTERNAL=y
BR2_TOOLCHAIN_EXTERNAL_CUSTOM=y
BR2_TOOLCHAIN_EXTERNAL_PATH="$(BR2_EXTERNAL)/toolchain/"
BR2_TOOLCHAIN_EXTERNAL_CUSTOM_PREFIX="mipsel-mchp-linux-uclibc"
BR2_TOOLCHAIN_EXTERNAL_GCC_4_7=y
BR2_TOOLCHAIN_EXTERNAL_HEADERS_4_0=y
BR2_TOOLCHAIN_EXTERNAL_WCHAR=y
BR2_TOOLCHAIN_EXTERNAL_INET_RPC=y
BR2_TOOLCHAIN_EXTERNAL_CXX=y
BR2_TOOLCHAIN_EXTERNAL_GDB_SERVER_COPY=y
BR2_ENABLE_LOCALE_PURGE=y
BR2_ENABLE_LOCALE_WHITELIST="C"
BR2_TARGET_GENERIC_HOSTNAME="pic32"
BR2_TARGET_GENERIC_ISSUE="Microchip PIC32MZDA Linux"
BR2_ROOTFS_DEVICE_CREATION_DYNAMIC_EUDEV=y
# BR2_TARGET_GENERIC_GETTY is not set
# BR2_TARGET_GENERIC_REMOUNT_ROOTFS_RW is not set
BR2_SYSTEM_DHCP="eth0"
BR2_ROOTFS_OVERLAY="$(BR2_EXTERNAL)/board/microchip/pic32mzda_evk/fs-overlay/"
BR2_ROOTFS_POST_IMAGE_SCRIPT="$(BR2_EXTERNAL)/board/microchip/pic32mzda_evk/finalize.sh $(BR2_EXTERNAL)/board/microchip/scripts/modules.sh"
BR2_ROOTFS_POST_SCRIPT_ARGS="$(BR2_EXTERNAL)"
BR2_LINUX_KERNEL=y
BR2_LINUX_KERNEL_CUSTOM_GIT=y
BR2_LINUX_KERNEL_CUSTOM_REPO_URL="https://github.com/MicrochipTech/linux-pic32.git"
BR2_LINUX_KERNEL_CUSTOM_REPO_VERSION="9be95753b0dbe5035b41faa1cc787762f2e5f9e8"
BR2_LINUX_KERNEL_USE_CUSTOM_CONFIG=y
BR2_LINUX_KERNEL_CUSTOM_CONFIG_FILE="$(BR2_EXTERNAL)/board/microchip/pic32mzda_evk/linux.config"
BR2_LINUX_KERNEL_DTS_SUPPORT=y
BR2_LINUX_KERNEL_USE_CUSTOM_DTS=y
BR2_LINUX_KERNEL_CUSTOM_DTS_PATH="$(BR2_EXTERNAL)/board/microchip/dts/4.2/pic32mzda_evk.dts $(BR2_EXTERNAL)/board/microchip/dts/4.2/pic32mzda_sk.dts $(BR2_EXTERNAL)/board/microchip/dts/4.2/pic32mzda-clk.dtsi  $(BR2_EXTERNAL)/board/microchip/dts/4.2/pic32mzda.dtsi"
BR2_PACKAGE_BUSYBOX_CONFIG="$(BR2_EXTERNAL)/board/microchip/pic32mzda_evk/busybox.config"
BR2_PACKAGE_ALSA_UTILS=y
BR2_PACKAGE_ALSA_UTILS_APLAY=y
BR2_PACKAGE_MPG123=y
BR2_PACKAGE_BZIP2=y
BR2_PACKAGE_XZ=y
BR2_PACKAGE_STRACE=y
BR2_PACKAGE_FB_TEST_APP=y
BR2_PACKAGE_EVTEST=y
BR2_PACKAGE_I2C_TOOLS=y
BR2_PACKAGE_PYTHON=y
BR2_PACKAGE_PYTHON_PY_PYC=y
# BR2_PACKAGE_PYTHON_UNICODEDATA is not set
BR2_PACKAGE_PYTHON_SERIAL=y
BR2_PACKAGE_TINYALSA=y
BR2_PACKAGE_OPENSSL=y
BR2_PACKAGE_SQLITE=y
BR2_PACKAGE_SQLITE_READLINE=y
BR2_PACKAGE_SQLITE_STAT3=y
BR2_PACKAGE_SQLITE_ENABLE_FTS3=y
BR2_PACKAGE_SQLITE_ENABLE_UNLOCK_NOTIFY=y
BR2_PACKAGE_BC=y
BR2_PACKAGE_BLUEZ_UTILS=y
BR2_PACKAGE_BLUEZ_UTILS_COMPAT=y
BR2_PACKAGE_BLUEZ_UTILS_AUDIO=y
BR2_PACKAGE_BLUEZ_UTILS_USB=y
BR2_PACKAGE_BLUEZ_UTILS_GATT=y
BR2_PACKAGE_DROPBEAR=y
BR2_PACKAGE_DROPBEAR_DISABLE_REVERSEDNS=y
BR2_PACKAGE_NANO=y
BR2_TARGET_UBOOT=y
BR2_TARGET_UBOOT_BOARDNAME="pic32mzdask"
BR2_TARGET_UBOOT_CUSTOM_GIT=y
BR2_TARGET_UBOOT_CUSTOM_REPO_URL="https://github.com/MicrochipTech/u-boot-pic32.git"
BR2_TARGET_UBOOT_CUSTOM_REPO_VERSION="39f330027acbe368fd054d9c19f196a03054eec2"
BR2_TARGET_UBOOT_FORMAT_ELF=y
```

## package/stage1/Config.in
```kconfig
config BR2_PACKAGE_STAGE1
	bool "PIC32 stage1 Bootloader"
	help
	  PIC32 stage1 bootloader with flashing utility.

#if BR2_PACKAGE_STAGE1
#
#config BR2_PACKAGE_STAGE1_PYTHON_WRAPPER
#        bool "Python wrapper"
#        help
#          This option enables Python wrapper creation for libonrisc
#endif
```
